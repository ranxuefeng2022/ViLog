## docs/charger/Kconfig
```kconfig
# hm 框架父目录的 Kconfig.
# 挪进内核树时按真实位置调整下方 source 路径; 若本目录落在
# drivers/hm/, 路径不变, 在 drivers/Kconfig 末尾追加:
#   source "drivers/hm/Kconfig"
source "drivers/hm/hm-common/Kconfig"
source "drivers/hm/hm-charger/Kconfig"
source "drivers/hm/hm-battery/Kconfig"
```

## docs/charger/hm-battery/Kconfig
```kconfig
config HM_BATTERY
	bool "HM battery psy (FG read/expose)"
	depends on OF && POWER_SUPPLY && HM_COMMON
	help
	  hm 电池侧 psy 驱动: 注册名为 "battery" 的 power supply
	  (Android health HAL 按名查找), 轮询 FG 并暴露电池数据:
	  status / capacity / 电压 / 电流 / 温度. 纯信息层: 所有值
	  读自 FG(status 也是, 不做本地合成), 不做 JEITA/过欠压
	  判决; 策略类消费者经 hm-charger 的 votable 自行投票.

	  注意: bool 而非 tristate, 只允许内建 (=y), 与全部 hm
	  模块的内建策略一致.
```

## docs/charger/hm-charger/Kconfig
```kconfig
config HM_CHARGER
	bool "HM charger info hub (usb psy + charger detection + votables)"
	depends on OF && POWER_SUPPLY && HM_COMMON
	help
	  hm 充电信息中枢: usb power supply + 充电检测管线 + 七个
	  votable 仲裁. usb psy 经 supplied_to 向若干其它 psy 供电,
	  支持用户空间写 ONLINE / INPUT_CURRENT_LIMIT.

	  注意: bool 而非 tristate -- 只允许内建 (=y), 无法做成模块
	  (.ko). 菜单只有内建选项, 没有 <M>; 即使手工把 Makefile 改
	  成 obj-m, Kconfig 也不会生成 CONFIG_HM_CHARGER=m.
```

## docs/charger/hm-common/Kconfig
```kconfig
config HM_COMMON
	bool "HM common support library (voter, event bus)"
	help
	  hm 模块的共享支持库: voter 投票框架与 hm_event 模块间
	  事件总线.

	  注意:
	  - bool 而非 tristate, 与 hm 模块全内建策略一致(=m 的库
	    被 =y 的使用者引用会链接失败, 不留这个坑);
	  - voter.o 与 hm_event.o 整个内核只构建一次; 模块经头文件
	    与导出符号使用它们, 严禁在自己的 Makefile 里再次编译
	    本目录源码(重复副本会分裂 votable 名字注册表,
	    find_votable() 将永远找不到其它模块创建的 votable).

	  各 hm 模块的 Kconfig 应 depends on HM_COMMON.
```
